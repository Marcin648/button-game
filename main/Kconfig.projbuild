## main/Kconfig.projbuild
```kconfig
menu "Button Game Configuration"

    choice BUTTON_GAME_VARIANT
        prompt "Device role configuration"
        help
            Select between central controller (Master) or interactive button unit (Slave).
            Master coordinates game logic, Slave handles physical button interaction.

        config BUTTON_GAME_VARIANT_MASTER
            bool "Central Controller (Master)"
            help
                USB-connected game coordinator managing multiple button units.
                Handles game logic, and USB communication.

        config BUTTON_GAME_VARIANT_SLAVE
            bool "Button Unit (Slave)"
            help
                Standalone peripheral with physical button and LEDs.
                Connects to Master device.
    endchoice

    if BUTTON_GAME_VARIANT_SLAVE
        config BUTTON_GAME_PIN_LED_POWER
            int "Power status LED GPIO"
            default 15
            range 0 39
            help
                GPIO number for power indicator LED

        config BUTTON_GAME_PIN_LED_BUTTON
            int "Button feedback LED GPIO"
            default 3
            range 0 39
            help
                GPIO for button reaction LED

        config BUTTON_GAME_PIN_BUTTON
            int "Main button input GPIO"
            default 14
            range 0 39
            help
                GPIO connected to momentary push button
    endif
endmenu
```
